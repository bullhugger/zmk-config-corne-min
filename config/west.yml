## config/west.yml
```yaml
manifest:
  remotes:
    - name: zmkfirmware
      url-base: https://github.com/zmkfirmware
    - name: mechboards
      url-base: https://github.com/MechboardsLTD

  projects:
    - name: zmk
      remote: zmkfirmware
      revision: v2.0
      import: app/west.yml

    - name: zmk-module
      remote: mechboards
      revision: main
      
  self:
    path: config
```
